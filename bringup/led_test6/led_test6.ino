#include <Arduino.h>

#define NIB(p)    (0xFu << ((p) * 4))
#define CFG_FLT   0x4u
#define CFG_OUT2  0x2u
#define CFG_PU    0x8u

static const uint8_t K_DPIN[6] = {0, 2, 3, 4, 5, 6};
#define D_CATH_MASK (NIB(0) | NIB(2) | NIB(3) | NIB(4) | NIB(5) | NIB(6))
#define D_CATH_FLT  (0x44444444u & D_CATH_MASK)
#define D_OUT_MASK  ((1u<<0) | (1u<<2) | (1u<<3) | (1u<<4) | (1u<<5) | (1u<<6))

static uint8_t fb[7];
static uint8_t buf[7];
static inline void present() { for (uint8_t i = 0; i < 7; i++) fb[i] = buf[i]; }
static inline void clearBuf() { for (uint8_t i = 0; i < 7; i++) buf[i] = 0; }
static inline void setPx(uint8_t r, uint8_t c) { buf[r] |= (uint8_t)(1u << c); }

static void blankAll() {
  GPIOC->CFGLR = 0x44444444u;
  GPIOD->CFGLR = (GPIOD->CFGLR & ~D_CATH_MASK) | D_CATH_FLT;
}

static void driveRow(uint8_t r) {
  uint8_t cols = fb[r];
  uint32_t cfgC = 0x44444444u, outC = 0;
  uint32_t cfgD = D_CATH_FLT,  outD = 0;
  cfgC = (cfgC & ~NIB(r)) | (CFG_OUT2 << (r * 4));
  for (uint8_t c = 0; c < 7; c++) {
    if (!(cols & (1u << c))) continue;
    if (c == 0) { cfgC = (cfgC & ~NIB(7)) | (CFG_OUT2 << 28); outC |= (1u << 7); }
    else { uint8_t p = K_DPIN[c - 1]; cfgD = (cfgD & ~NIB(p)) | (CFG_OUT2 << (p * 4)); outD |= (1u << p); }
  }
  blankAll();
  if (!cols) return;
  GPIOC->OUTDR = outC;
  GPIOD->OUTDR = (GPIOD->OUTDR & ~D_OUT_MASK) | outD;
  GPIOC->CFGLR = cfgC;
  GPIOD->CFGLR = (GPIOD->CFGLR & ~D_CATH_MASK) | cfgD;
}

static const uint8_t FONT[39][5] = {
  {0x3E,0x51,0x49,0x45,0x3E},{0x00,0x42,0x7F,0x40,0x00},{0x42,0x61,0x51,0x49,0x46},
  {0x21,0x41,0x45,0x4B,0x31},{0x18,0x14,0x12,0x7F,0x10},{0x27,0x45,0x45,0x45,0x39},
  {0x3C,0x4A,0x49,0x49,0x30},{0x01,0x71,0x09,0x05,0x03},{0x36,0x49,0x49,0x49,0x36},
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  {0x00,0x00,0x5F,0x00,0x00},{0x08,0x08,0x08,0x08,0x08},{0x00,0x00,0x00,0x00,0x00}
};

static const char TEXT[] = "HELLO  ";

static uint8_t textColumn(int16_t i) {
  if (i < 0) return 0;
  uint16_t ch = i / 6, k = i % 6;
  if (ch >= sizeof(TEXT) - 1 || k == 5) return 0;
  char ct = TEXT[ch];
  uint8_t g;
  if (ct >= '0' && ct <= '9')      g = ct - '0';
  else if (ct >= 'A' && ct <= 'Z') g = 10 + (ct - 'A');
  else if (ct >= 'a' && ct <= 'z') g = 10 + (ct - 'a');
  else if (ct == '!')              g = 36;
  else if (ct == '-')              g = 37;
  else                             g = 38;
  return FONT[g][k];
}

void setup() {
  RCC->APB2PCENR |= (1u << 2) | (1u << 4) | (1u << 5);
  blankAll();
}

static uint16_t st = 0;

void loop() {
  static uint8_t row = 0;
  static uint32_t tRow = 0;
  uint32_t nowUs = micros();
  if ((uint32_t)(nowUs - tRow) >= 250) {
    tRow = nowUs;
    driveRow(row);
    if (++row >= 7) row = 0;
  }

  static uint32_t tFx = 0;
  uint32_t ms = millis();
  if ((uint32_t)(ms - tFx) >= 80) {
    tFx = ms;
    // scroll effect
    uint16_t total = (sizeof(TEXT) - 1) * 6;
    clearBuf();
    for (uint8_t c = 0; c < 7; c++) {
      uint8_t colBits = textColumn((int16_t)st + c - 7);
      for (uint8_t r = 0; r < 7; r++) if (colBits & (1u << r)) setPx(r, c);
    }
    if (++st > total + 7) st = 0;
    present();
  }
}
